## configs/BSC9131RDB_NAND_defconfig
```kconfig
CONFIG_PPC=y
CONFIG_MPC85xx=y
CONFIG_TARGET_BSC9131RDB=y
CONFIG_SPL=y
CONFIG_FIT=y
CONFIG_FIT_VERBOSE=y
CONFIG_OF_BOARD_SETUP=y
CONFIG_OF_STDOUT_VIA_ALIAS=y
CONFIG_SYS_EXTRA_OPTIONS="BSC9131RDB,NAND"
# CONFIG_CMD_IMLS is not set
# CONFIG_CMD_FLASH is not set
CONFIG_MTD_SPI_NOR=y
CONFIG_MTD_M25P80=y
CONFIG_SPI_NOR_SPANSION=y
CONFIG_SYS_NS16550=y
CONFIG_FSL_ESPI=y
CONFIG_OF_LIBFDT=y
```

## configs/M52277EVB_defconfig
```kconfig
CONFIG_M68K=y
CONFIG_TARGET_M52277EVB=y
CONFIG_SYS_TEXT_BASE=0x00000000
CONFIG_SYS_EXTRA_OPTIONS="SYS_SPANSION_BOOT"
CONFIG_SYS_PROMPT="-> "
# CONFIG_CMD_SETEXPR is not set
# CONFIG_CMD_NET is not set
# CONFIG_CMD_NFS is not set
CONFIG_MTD_SPI_NOR=y
CONFIG_MTD_M25P80=y
CONFIG_SPI_NOR_STMICRO=y
```

## configs/M54455EVB_a66_defconfig
```kconfig
CONFIG_M68K=y
CONFIG_TARGET_M54455EVB=y
CONFIG_SYS_TEXT_BASE=0x04000000
CONFIG_SYS_EXTRA_OPTIONS="SYS_ATMEL_BOOT,SYS_INPUT_CLKSRC=66666666"
# CONFIG_CMD_LOADB is not set
# CONFIG_CMD_LOADS is not set
# CONFIG_CMD_SETEXPR is not set
CONFIG_MTD_SPI_NOR=y
CONFIG_MTD_M25P80=y
CONFIG_SPI_NOR_STMICRO=y
```

## configs/M54455EVB_stm33_defconfig
```kconfig
CONFIG_M68K=y
CONFIG_TARGET_M54455EVB=y
CONFIG_SYS_TEXT_BASE=0x4FE00000
CONFIG_SYS_EXTRA_OPTIONS="SYS_STMICRO_BOOT,CF_SBF,SYS_INPUT_CLKSRC=33333333"
# CONFIG_CMD_LOADB is not set
# CONFIG_CMD_LOADS is not set
# CONFIG_CMD_SETEXPR is not set
CONFIG_MTD_SPI_NOR=y
CONFIG_MTD_M25P80=y
CONFIG_SPI_NOR_STMICRO=y
```

## configs/am335x_evm_norboot_defconfig
```kconfig
CONFIG_ARM=y
CONFIG_TARGET_AM335X_EVM=y
CONFIG_NOR=y
CONFIG_NOR_BOOT=y
CONFIG_FIT=y
# CONFIG_CMD_IMLS is not set
CONFIG_CMD_GPIO=y
# CONFIG_CMD_SETEXPR is not set
CONFIG_MTD_SPI_NOR=y
CONFIG_MTD_M25P80=y
CONFIG_SPI_NOR_WINBOND=y
CONFIG_SYS_NS16550=y
CONFIG_OF_LIBFDT=y
```

## configs/am43xx_evm_qspiboot_defconfig
```kconfig
CONFIG_ARM=y
CONFIG_TARGET_AM43XX_EVM=y
CONFIG_SYS_EXTRA_OPTIONS="SERIAL1,CONS_INDEX=1,QSPI,QSPI_BOOT"
# CONFIG_CMD_IMLS is not set
# CONFIG_CMD_FLASH is not set
CONFIG_CMD_GPIO=y
# CONFIG_CMD_SETEXPR is not set
CONFIG_MTD_SPI_NOR=y
CONFIG_MTD_M25P80=y
CONFIG_SPI_NOR_MACRONIX=y
CONFIG_SYS_NS16550=y
CONFIG_TI_QSPI=y
CONFIG_OF_LIBFDT=y
```

## configs/aristainetos_defconfig
```kconfig
CONFIG_ARM=y
CONFIG_ARCH_MX6=y
CONFIG_TARGET_ARISTAINETOS=y
CONFIG_FIT=y
CONFIG_SYS_EXTRA_OPTIONS="IMX_CONFIG=board/aristainetos/aristainetos.cfg,MX6DL"
# CONFIG_CMD_IMLS is not set
# CONFIG_CMD_FLASH is not set
CONFIG_CMD_GPIO=y
CONFIG_MTD_SPI_NOR=y
CONFIG_MTD_M25P80=y
CONFIG_SPI_FLASH_STMICRO=y
CONFIG_OF_LIBFDT=y
```

## configs/at91sam9n12ek_spiflash_defconfig
```kconfig
CONFIG_ARM=y
CONFIG_ARCH_AT91=y
CONFIG_TARGET_AT91SAM9N12EK=y
CONFIG_SPL=y
CONFIG_SYS_EXTRA_OPTIONS="AT91SAM9N12,SYS_USE_SPIFLASH"
CONFIG_SYS_PROMPT="U-Boot> "
# CONFIG_CMD_IMLS is not set
# CONFIG_CMD_FLASH is not set
# CONFIG_CMD_FPGA is not set
# CONFIG_CMD_SETEXPR is not set
CONFIG_MTD_SPI_NOR=y
CONFIG_MTD_M25P80=y
CONFIG_SPI_NOR_MISC=y
CONFIG_OF_LIBFDT=y
```

## configs/bf518f-ezbrd_defconfig
```kconfig
CONFIG_BLACKFIN=y
CONFIG_TARGET_BF518F_EZBRD=y
CONFIG_CMD_GPIO=y
# CONFIG_CMD_SETEXPR is not set
CONFIG_NET_RANDOM_ETHADDR=y
CONFIG_MTD_SPI_NOR=y
CONFIG_MTD_M25P80=y
CONFIG_SPI_FLASH_STMICRO=y
CONFIG_SPI_FLASH_SST=y
CONFIG_CC_OPTIMIZE_LIBS_FOR_SPEED=y
```

## configs/bf525-ucr2_defconfig
```kconfig
CONFIG_BLACKFIN=y
CONFIG_TARGET_BF525_UCR2=y
# CONFIG_CMD_IMLS is not set
# CONFIG_CMD_FLASH is not set
# CONFIG_CMD_SETEXPR is not set
# CONFIG_CMD_NET is not set
# CONFIG_CMD_NFS is not set
CONFIG_MTD_SPI_NOR=y
CONFIG_MTD_M25P80=y
CONFIG_SPI_FLASH_EON=y
```

## configs/bf526-ezbrd_defconfig
```kconfig
CONFIG_BLACKFIN=y
CONFIG_TARGET_BF526_EZBRD=y
CONFIG_CMD_GPIO=y
# CONFIG_CMD_SETEXPR is not set
CONFIG_NET_RANDOM_ETHADDR=y
CONFIG_MTD_SPI_NOR=y
CONFIG_MTD_M25P80=y
CONFIG_SPI_FLASH_SST=y
```

## configs/bf527-ezkit-v2_defconfig
```kconfig
CONFIG_BLACKFIN=y
CONFIG_TARGET_BF527_EZKIT=y
CONFIG_SYS_EXTRA_OPTIONS="BF527_EZKIT_REV_2_1"
CONFIG_CMD_GPIO=y
# CONFIG_CMD_SETEXPR is not set
CONFIG_MTD_SPI_NOR=y
CONFIG_MTD_M25P80=y
CONFIG_SPI_FLASH_STMICRO=y
CONFIG_LIB_RAND=y
```

## configs/bf527-ezkit_defconfig
```kconfig
CONFIG_BLACKFIN=y
CONFIG_TARGET_BF527_EZKIT=y
# CONFIG_CMD_SETEXPR is not set
CONFIG_NET_RANDOM_ETHADDR=y
# CONFIG_NET_TFTP_VARS is not set
CONFIG_MTD_SPI_NOR=y
CONFIG_MTD_M25P80=y
CONFIG_SPI_FLASH_STMICRO=y
```

## configs/bf527-sdp_defconfig
```kconfig
CONFIG_BLACKFIN=y
CONFIG_TARGET_BF527_SDP=y
# CONFIG_CMD_BOOTD is not set
CONFIG_CMD_GPIO=y
# CONFIG_CMD_SETEXPR is not set
# CONFIG_CMD_NET is not set
# CONFIG_CMD_NFS is not set
CONFIG_MTD_SPI_NOR=y
CONFIG_MTD_M25P80=y
CONFIG_SPI_NOR_MISC=y
CONFIG_SPI_NOR_MACRONIX=y
CONFIG_SPI_NOR_SPANSION=y
CONFIG_SPI_NOR_STMICRO=y
CONFIG_SPI_NOR_SST=y
CONFIG_SPI_NOR_WINBOND=y
CONFIG_CC_OPTIMIZE_LIBS_FOR_SPEED=y
```

## configs/bf537-pnav_defconfig
```kconfig
CONFIG_BLACKFIN=y
CONFIG_TARGET_BF537_PNAV=y
CONFIG_CMD_GPIO=y
# CONFIG_CMD_SETEXPR is not set
CONFIG_NET_RANDOM_ETHADDR=y
CONFIG_MTD_SPI_NOR=y
CONFIG_MTD_M25P80=y
CONFIG_SPI_FLASH_STMICRO=y
```

## configs/bf537-stamp_defconfig
```kconfig
CONFIG_BLACKFIN=y
CONFIG_TARGET_BF537_STAMP=y
CONFIG_CMD_GPIO=y
# CONFIG_CMD_SETEXPR is not set
CONFIG_NET_RANDOM_ETHADDR=y
CONFIG_MTD_SPI_NOR=y
CONFIG_MTD_M25P80=y
CONFIG_SPI_NOR_MISC=y
CONFIG_SPI_NOR_MACRONIX=y
CONFIG_SPI_NOR_SPANSION=y
CONFIG_SPI_NOR_STMICRO=y
CONFIG_SPI_NOR_SST=y
CONFIG_SPI_NOR_WINBOND=y
```

## configs/bf548-ezkit_defconfig
```kconfig
CONFIG_BLACKFIN=y
CONFIG_TARGET_BF548_EZKIT=y
CONFIG_CMD_GPIO=y
# CONFIG_CMD_SETEXPR is not set
CONFIG_MTD_SPI_NOR=y
CONFIG_MTD_M25P80=y
CONFIG_SPI_FLASH_STMICRO=y
CONFIG_CC_OPTIMIZE_LIBS_FOR_SPEED=y
CONFIG_LIB_RAND=y
```

## configs/bf561-acvilon_defconfig
```kconfig
CONFIG_BLACKFIN=y
CONFIG_TARGET_BF561_ACVILON=y
CONFIG_SYS_PROMPT="Acvilon> "
# CONFIG_CMD_IMLS is not set
# CONFIG_CMD_FLASH is not set
CONFIG_CMD_GPIO=y
# CONFIG_CMD_SETEXPR is not set
CONFIG_MTD_SPI_NOR=y
CONFIG_MTD_M25P80=y
CONFIG_SPI_FLASH_ATMEL=y
CONFIG_CC_OPTIMIZE_LIBS_FOR_SPEED=y
CONFIG_LIB_RAND=y
```

## configs/bf609-ezkit_defconfig
```kconfig
CONFIG_BLACKFIN=y
CONFIG_TARGET_BF609_EZKIT=y
CONFIG_CMD_GPIO=y
# CONFIG_CMD_SETEXPR is not set
CONFIG_MTD_SPI_NOR=y
CONFIG_MTD_M25P80=y
CONFIG_SPI_NOR_MISC=y
CONFIG_SPI_NOR_MACRONIX=y
CONFIG_SPI_NOR_SPANSION=y
CONFIG_SPI_NOR_STMICRO=y
CONFIG_SPI_NOR_SST=y
CONFIG_SPI_NOR_WINBOND=y
CONFIG_NETDEVICES=y
CONFIG_ETH_DESIGNWARE=y
CONFIG_LIB_RAND=y
```

## configs/bg0900_defconfig
```kconfig
CONFIG_ARM=y
CONFIG_TARGET_BG0900=y
CONFIG_SPL=y
# CONFIG_CMD_IMLS is not set
# CONFIG_CMD_FLASH is not set
CONFIG_CMD_GPIO=y
CONFIG_MTD_SPI_NOR=y
CONFIG_MTD_M25P80=y
CONFIG_SPI_NOR_BAR=y
CONFIG_SPI_FLASH_STMICRO=y
CONFIG_OF_LIBFDT=y
```

## configs/birdland_bav335a_defconfig
```kconfig
CONFIG_ARM=y
CONFIG_TARGET_BAV335X=y
CONFIG_BAV_VERSION=1
CONFIG_SPL=y
CONFIG_FIT=y
CONFIG_SYS_EXTRA_OPTIONS="SERIAL1,CONS_INDEX=1"
# CONFIG_CMD_IMLS is not set
# CONFIG_CMD_FLASH is not set
CONFIG_CMD_GPIO=y
# CONFIG_CMD_SETEXPR is not set
CONFIG_MTD_SPI_NOR=y
CONFIG_MTD_M25P80=y
CONFIG_SPI_NOR_WINBOND=y
CONFIG_SYS_NS16550=y
CONFIG_OF_LIBFDT=y
```

## configs/blackstamp_defconfig
```kconfig
CONFIG_BLACKFIN=y
CONFIG_TARGET_BLACKSTAMP=y
# CONFIG_CMD_IMLS is not set
# CONFIG_CMD_FLASH is not set
# CONFIG_CMD_SETEXPR is not set
CONFIG_MTD_SPI_NOR=y
CONFIG_MTD_M25P80=y
CONFIG_SPI_NOR_STMICRO=y
```

## configs/cm_t43_defconfig
```kconfig
CONFIG_ARM=y
CONFIG_TARGET_CM_T43=y
CONFIG_DM_GPIO=y
CONFIG_SPL=y
CONFIG_SYS_PROMPT="CM-T43 # "
# CONFIG_CMD_FLASH is not set
CONFIG_CMD_SF=y
CONFIG_CMD_USB=y
# CONFIG_CMD_FPGA is not set
CONFIG_CMD_GPIO=y
# CONFIG_CMD_NFS is not set
CONFIG_DM=y
CONFIG_SYS_NS16550=y
CONFIG_OF_LIBFDT=y
CONFIG_DM_SERIAL=y
CONFIG_MTD_SPI_NOR=y
CONFIG_MTD_M25P80=y
CONFIG_SPI_NOR_BAR=y
CONFIG_SPI_NOR_MISC=y
CONFIG_SPI_NOR_WINBOND=y
CONFIG_SPI_NOR_SST=y
CONFIG_SPI_NOR_STMICRO=y
CONFIG_SPI_NOR_SPANSION=y
CONFIG_SPI_NOR_MACRONIX=y
```

## configs/cougarcanyon2_defconfig
```kconfig
CONFIG_X86=y
CONFIG_VENDOR_INTEL=y
CONFIG_DEFAULT_DEVICE_TREE="cougarcanyon2"
CONFIG_TARGET_COUGARCANYON2=y
# CONFIG_CMD_IMLS is not set
# CONFIG_CMD_FLASH is not set
CONFIG_CMD_GPIO=y
# CONFIG_CMD_SETEXPR is not set
# CONFIG_CMD_NFS is not set
CONFIG_OF_CONTROL=y
CONFIG_MTD_SPI_NOR=y
CONFIG_MTD_M25P80=y
CONFIG_SPI_NOR_WINBOND=y
CONFIG_DM_PCI=y
CONFIG_DM_RTC=y
CONFIG_SYS_NS16550=y
CONFIG_ICH_SPI=y
CONFIG_TIMER=y
CONFIG_USB=y
CONFIG_DM_USB=y
CONFIG_USE_PRIVATE_LIBGCC=y
```

## configs/da850evm_direct_nor_defconfig
```kconfig
CONFIG_ARM=y
CONFIG_ARCH_DAVINCI=y
CONFIG_TARGET_DA850EVM=y
CONFIG_SYS_EXTRA_OPTIONS="MAC_ADDR_IN_SPIFLASH,USE_NOR,DIRECT_NOR_BOOT"
CONFIG_SYS_PROMPT="U-Boot > "
# CONFIG_CMD_SETEXPR is not set
CONFIG_MTD_SPI_NOR=y
CONFIG_MTD_M25P80=y
CONFIG_SPI_NOR_STMICRO=y
CONFIG_SPI_NOR_WINBOND=y
CONFIG_SYS_NS16550=y
CONFIG_OF_LIBFDT=y
```
